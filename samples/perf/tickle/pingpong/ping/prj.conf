## CMakeLists.txt
```
# SPDX-License-Identifier: Apache-2.0

cmake_minimum_required(VERSION 3.20.0)
find_package(Zephyr REQUIRED HINTS $ENV{ZEPHYR_BASE})
project(perf_tickle_ping)

set(TICKLE_DIR ${CMAKE_CURRENT_LIST_DIR}/../../tickle)
set(TICKLE_INCLUDE_DIRS ${TICKLE_DIR}/include)
set(TICKLE_SOURCES
  ${TICKLE_DIR}/src/encoding.c
  ${TICKLE_DIR}/src/hal_zephyr.c
  ${TICKLE_DIR}/src/log.c
  ${TICKLE_DIR}/src/tickle.c
)

set(LAN8651_DIR ${CMAKE_CURRENT_LIST_DIR}/../../../lan8651)
set(LAN8651_INCLUDE_DIRS ${LAN8651_DIR}/include)
set(LAN8651_SOURCES
  ${LAN8651_DIR}/src/lan8651.c
  ${LAN8651_DIR}/src/spi.c
)

target_include_directories(app PRIVATE ${TICKLE_INCLUDE_DIRS} ${LAN8651_INCLUDE_DIRS})
target_sources(app PRIVATE src/main.c src/Command.c src/State.c ${TICKLE_SOURCES} ${LAN8651_SOURCES})
```

## prj.conf
```kconfig
# TODO: Enable this when tickle is included as an external module
#CONFIG_TICKLE=y
CONFIG_SPI=y
```

## src/main.c
```c
#include <stdio.h>
#include <zephyr/kernel.h>

#include <zephyr/net/ethernet.h>
#include <zephyr/net/net_if.h>
#include <zephyr/net/net_mgmt.h>

#include <tickle/tickle.h>
#include "Command.h"
#include "State.h"

#define PING_INTERVAL_NS (1000ULL * NSEC_PER_USEC)

static struct tt_Node node;
static struct tt_Publisher pub;
static struct tt_Subscriber sub;

static void send_ping(struct tt_Node *node, uint64_t time, void *param)
{
	printk("Sending ping\n");
	tt_Node_schedule(node, time + PING_INTERVAL_NS, send_ping, NULL);
}

static void pong_callback(struct tt_Subscriber *sub, uint64_t timestamp, uint16_t seq_no, struct StateData *data)
{
	/* TODO: print timestamp */
	printk("Pong received\n");
}

int main(void)
{
	printk("Master Node Started\n");

	_tt_CONFIG.broadcast = "192.168.10.255";

	int32_t ret = tt_Node_create(&node);
	if (ret != 0) {
		printk("Failed to create node: %d\n", ret);
		return ret;
	}

	printk("Master Node Created, Node ID: %d\n", node.id);

	// ret = tt_Node_create_publisher(&node, &pub, &CommandTopic, "command_topic");
	// if (ret != 0) {
	// 	printk("Failed to create publisher: %d\n", ret);
	// 	return ret;
	// }

	// ret = tt_Node_create_subscriber(&node, &sub, &StateTopic, "state_topic",
	// 				(tt_SUBSCRIBER_CALLBACK)state_callback);
	// if (ret != 0) {
	// 	printk("Failed to create subscriber: %d\n", ret);
	// 	return ret;
	// }

	// tt_Node_schedule(&node, tt_get_ns() + PING_INTERVAL_NS, send_ping, NULL);

	tt_Node_poll(&node);

	tt_Node_destroy(&node);

	return 0;
}
```

## src/State.h
```c
#pragma once

#include <tickle/tickle.h>

struct StateData {
    uint8_t id;
    int32_t status;
};

extern struct tt_Topic StateTopic;

int32_t StateData_encode_size(struct StateData* request);
int32_t StateData_encode(struct StateData* request, uint8_t* payload, const int32_t len);
int32_t StateData_decode(struct StateData* request, const uint8_t* payload, const int32_t len, bool is_native_endian);
void StateData_free(struct StateData* request);
```

## CMakeLists.txt
```
# SPDX-License-Identifier: Apache-2.0

cmake_minimum_required(VERSION 3.20.0)
find_package(Zephyr REQUIRED HINTS $ENV{ZEPHYR_BASE})
project(robot_arm_master)

add_subdirectory(tickle)  # TODO: Include tickle as external module

target_include_directories(app PRIVATE ${TICKLE_INCLUDE_DIRS})
target_sources(app PRIVATE src/main.c src/Command.c src/State.c ${TICKLE_SOURCES})
```

## prj.conf
```kconfig
# TODO: Enable this when tickle is included as an external module
#CONFIG_TICKLE=y
CONFIG_POSIX_NETWORKING=y
CONFIG_POSIX_API=y

CONFIG_NETWORKING=y
CONFIG_NET_IPV4=y
CONFIG_NET_DHCPV4=n
CONFIG_NET_UDP=y
CONFIG_NET_SOCKETS=y

CONFIG_NET_CONFIG_SETTINGS=y
CONFIG_NET_CONFIG_NEED_IPV4=y
CONFIG_NET_CONFIG_MY_IPV4_ADDR="192.168.10.1"
CONFIG_NET_CONFIG_MY_IPV4_NETMASK="255.255.255.0"

CONFIG_MAIN_STACK_SIZE=16384

#CONFIG_SCHED_SCALABLE=y
#CONFIG_WAITQ_SCALABLE=y

CONFIG_NET_CONTEXT_RCVTIMEO=y
```

## boards/rpi_4b.overlay
```dts
&lan8651 {
	local-mac-address = [aa bb cc 00 00 00];
};

&lan865x_mdio {
	plca-enable;
	plca-node-id = <0>;
	plca-node-count = <3>;
	plca-burst-count = <0>;
	plca-burst-timer = <0x80>;
	plca-to-timer = <0x20>;
};
```

## src/main.c
```c
#include <stdio.h>
#include <zephyr/kernel.h>

#include <zephyr/net/ethernet.h>
#include <zephyr/net/net_if.h>
#include <zephyr/net/net_mgmt.h>

#include <tickle/tickle.h>
#include "Command.h"

#define ROBOT_ARM_COMMAND_INTERVAL_NS (2 * NSEC_PER_SEC)

static struct tt_Node node;
static struct tt_Publisher pub;

static void move_joint(uint8_t joint, int32_t angle) {
    struct CommandData command = {
        .joint = joint,
        .angle = angle,
    };
    int32_t ret = tt_Publisher_publish(&pub, (struct tt_Data*)&command);
    if (ret != 0) {
        printk("Failed to publish command: %d\n", ret);
    }
}

static void initial_state(void) {
    for (uint8_t i = 1; i <= 6; i++) {
        move_joint(i, 0);
    }
    k_msleep(2000);
    move_joint(1, 45);
    move_joint(2, 20);
    move_joint(3, 10);
    k_msleep(1000);
}

static void move_command(struct tt_Node* node, uint64_t time, void* param) {
    int64_t idx = (int64_t)param;

    printk("move %lld\n", idx);
    if (idx == 0) {
        move_joint(1, 25);
        move_joint(3, 25);
    } else {
        move_joint(1, 65);
        move_joint(3, 5);
    }

    tt_Node_schedule(node, time + ROBOT_ARM_COMMAND_INTERVAL_NS, move_command, (void*)(1 - idx));
}

int main(void)
{
    printk("Master Node Started\n");

    _tt_CONFIG.broadcast = "192.168.10.255";

    int32_t ret = tt_Node_create(&node);
    if (ret != 0) {
        printk("Failed to create node: %d\n", ret);
        return ret;
    }

    printk("Master Node Created, Node ID: %d\n", node.id);

    ret = tt_Node_create_publisher(&node, &pub, &CommandTopic, "command_topic");
    if (ret != 0) {
        printk("Failed to create publisher: %d\n", ret);
        return ret;
    }

    k_msleep(5000);  /* Wait for calibration,  TODO: Use services to check if calibration is done */

    initial_state();

    tt_Node_schedule(&node, tt_get_ns() + ROBOT_ARM_COMMAND_INTERVAL_NS, move_command, (void*)0);

    tt_Node_poll(&node);

    tt_Node_destroy(&node);

	return 0;
}
```

## src/Command.c
```c
#include "Command.h"

#include <tickle/hal.h>
#include <zephyr/sys/byteorder.h>

struct tt_Topic CommandTopic = {
	.name = "CommandTopic",
	.data_size = sizeof(struct CommandData),
	.data_encode_size = (tt_DATA_ENCODE_SIZE)CommandData_encode_size,
	.data_encode = (tt_DATA_ENCODE)CommandData_encode,
	.data_decode = (tt_DATA_DECODE)CommandData_decode,
	.data_free = (tt_DATA_FREE)CommandData_free,
};

int32_t CommandData_encode_size(struct CommandData *data)
{
	return sizeof(uint8_t) + sizeof(int32_t);
}

int32_t CommandData_encode(struct CommandData *data, uint8_t *payload, const int32_t len)
{
	int32_t encoded = 0;

	if (encoded + sizeof(uint8_t) > len) {
		return -1;
	}

	*(uint8_t *)payload = data->joint;

	encoded += sizeof(uint8_t);
	payload += sizeof(uint8_t);

	if (encoded + sizeof(int32_t) > len) {
		return -1;
	}

	*(int32_t *)payload = sys_cpu_to_be32(data->angle);
	payload += sizeof(int32_t);
	encoded += sizeof(int32_t);

	return encoded;
}

int32_t CommandData_decode(struct CommandData *data, const uint8_t *payload, const int32_t len,
			   bool is_native_endian)
{
	int32_t decoded = 0;

	if (decoded + sizeof(uint8_t) > len) {
		return -1;
	}

	data->joint = *(uint8_t *)payload;

	decoded += sizeof(uint8_t);
	payload += sizeof(uint8_t);

	if (decoded + sizeof(int32_t) > len) {
		return -1;
	}

	data->angle = sys_be32_to_cpu(*(int32_t *)payload);

	decoded += sizeof(int32_t);
	payload += sizeof(int32_t);

	return decoded;
}

void CommandData_free(struct CommandData *data)
{
	// Do nothing
}
```

## prj.conf
```kconfig
# Core SPI
CONFIG_SPI=y
CONFIG_SPI_DW=y
CONFIG_SPI_DW_USE_IRQ=n
CONFIG_SPI_DW_POLLING_TIMEOUT_US=50000

# =========================
# Pin Controller
# =========================
CONFIG_PINCTRL=y
CONFIG_PINCTRL_RP1=y
# Logging for RP1 pinctrl
CONFIG_PINCTRL_RP1_LOG_LEVEL_DBG=y

# Ensure GPIO is enabled (required for bitbang)
CONFIG_GPIO=y

# Network stack
CONFIG_NET_ARP=y
CONFIG_NET_IPV4=y
CONFIG_NET_SOCKETS=y
CONFIG_NET_CONFIG_SETTINGS=y
CONFIG_NET_CONFIG_NEED_IPV4=y

CONFIG_NET_IF_UNICAST_IPV4_ADDR_COUNT=2
CONFIG_NET_IF_MCAST_IPV4_ADDR_COUNT=1
CONFIG_NET_CONFIG_MY_IPV4_ADDR="10.1.1.5"
CONFIG_NET_CONFIG_MY_IPV4_NETMASK="255.255.255.0"
CONFIG_NET_CONFIG_MY_IPV4_GW="0.0.0.0"
CONFIG_NET_CONFIG_INIT_TIMEOUT=5

CONFIG_NET_PKT_TX_COUNT=32
CONFIG_NET_PKT_RX_COUNT=32

CONFIG_NET_BUF_TX_COUNT=128
CONFIG_NET_BUF_RX_COUNT=128

CONFIG_NET_BUF_DATA_SIZE=256

CONFIG_NETWORKING=y
CONFIG_NET_L2_ETHERNET=y
CONFIG_NET_IPV4=y
CONFIG_NET_IPV6=n
CONFIG_NET_TCP=n
CONFIG_NET_UDP=y
CONFIG_NET_MGMT=y
CONFIG_NET_MGMT_EVENT=y
CONFIG_NET_MGMT_EVENT_INFO=y
CONFIG_ETHERNET_LOG_LEVEL_DBG=y

# TCP
CONFIG_NET_MAX_CONTEXTS=8
CONFIG_NET_MAX_CONN=8
CONFIG_ZVFS_POLL_MAX=4
CONFIG_ZVFS_OPEN_MAX=8

# LAN865x + MDIO
CONFIG_ETH_LAN865X=y
CONFIG_MDIO=y
CONFIG_MDIO_LAN865X=y
CONFIG_ETH_LAN865X_USE_IRQ=n
CONFIG_ETH_LAN865X_IRQ_THREAD_PRIO=10
CONFIG_ETH_LAN865X_IRQ_THREAD_STACK_SIZE=4096
CONFIG_ETH_LAN865X_POLL_INTERVAL_MS=1
CONFIG_ETH_LAN865X_BURST_CHUNKS=24

# === Console / UART ===
CONFIG_SERIAL=y
CONFIG_CONSOLE=y
CONFIG_UART_CONSOLE=y
CONFIG_UART_INTERRUPT_DRIVEN=y

# Shell
CONFIG_SHELL=y
CONFIG_SHELL_BACKEND_SERIAL=y
CONFIG_SHELL_BACKEND_SERIAL_INIT_PRIORITY=50

# printk / log
CONFIG_PRINTK=y
CONFIG_LOG=y
CONFIG_LOG_BACKEND_UART=y
CONFIG_LOG_MODE_IMMEDIATE=y
CONFIG_LOG_DEFAULT_LEVEL=4

CONFIG_PM=y
CONFIG_PM_DEVICE=y

CONFIG_PCIE=y
CONFIG_PCIE_CONTROLLER=y
CONFIG_PCIE_MSI=y
CONFIG_PCIE_MSI_X=y
CONFIG_DYNAMIC_INTERRUPTS=y
CONFIG_PCIE_MSI_MULTI_VECTOR=y
CONFIG_PCIE_LOG_LEVEL_DBG=y

CONFIG_I2C=n
CONFIG_I2C_DW=n
CONFIG_I2C_SHELL=n
CONFIG_I2C_LOG_LEVEL_DBG=n

CONFIG_GPIO_FXL6408=n

CONFIG_KERNEL_LOG_LEVEL_INF=y
CONFIG_KERNEL_LOG_LEVEL_DBG=n
```

## src/main.c
```c
#include <zephyr/kernel.h>
#include <zephyr/sys/printk.h>

#include <zephyr/net/socket.h>
#include <zephyr/net/net_if.h>
#include <zephyr/net/net_ip.h>

#include <stdint.h>
#include <stddef.h>
#include <string.h>
#include <errno.h>

#define PAYLOAD_SIZE 1472U
#define PEER_IP_STR  "10.1.1.10"
#define PEER_PORT    5000

static uint8_t tx_buf[PAYLOAD_SIZE];

static int wait_for_iface_up(struct net_if *iface, int timeout_ms)
{
	int waited_ms = 0;

	while (waited_ms < timeout_ms) {
		if ((iface != NULL) && net_if_is_up(iface)) {
			return 0;
		}

		k_sleep(K_MSEC(100));
		waited_ms += 100;
	}

	return -ETIMEDOUT;
}

int main(void)
{
	struct net_if *iface;
	struct sockaddr_in peer_addr;
	int sock;
	int ret;

	uint64_t total_bytes = 0U;
	uint64_t total_pkts = 0U;
	uint64_t total_send_err = 0U;

	uint64_t window_bytes = 0U;
	uint64_t window_pkts = 0U;
	uint64_t window_send_err = 0U;

	int64_t window_start_ms;
	int64_t total_start_ms;

	printk("Hello World! eth_lan865x tx path continuous sender start\n");
	printk("  PAYLOAD_SIZE=%u\n", PAYLOAD_SIZE);
	printk("  PEER=%s:%u\n", PEER_IP_STR, PEER_PORT);

	/* Allow driver and interface initialization to complete. */
	k_sleep(K_SECONDS(2));

	iface = net_if_get_default();
	if (iface == NULL) {
		printk("default network interface is NULL\n");
		return 0;
	}

	ret = wait_for_iface_up(iface, 5000);
	if (ret < 0) {
		printk("network interface is not up\n");
		return 0;
	}

	for (size_t i = 0; i < PAYLOAD_SIZE; i++) {
		tx_buf[i] = (uint8_t)(i & 0xff);
	}

	sock = zsock_socket(AF_INET, SOCK_DGRAM, IPPROTO_UDP);
	if (sock < 0) {
		printk("socket() failed: %d\n", errno);
		return 0;
	}

	memset(&peer_addr, 0, sizeof(peer_addr));
	peer_addr.sin_family = AF_INET;
	peer_addr.sin_port = htons(PEER_PORT);

	ret = zsock_inet_pton(AF_INET, PEER_IP_STR, &peer_addr.sin_addr);
	if (ret != 1) {
		printk("inet_pton() failed for peer ip %s\n", PEER_IP_STR);
		zsock_close(sock);
		return 0;
	}

	window_start_ms = k_uptime_get();
	total_start_ms = window_start_ms;

	while (1) {
		ssize_t sent;
		int64_t now_ms;
		uint64_t total_elapsed_ms;
		uint64_t window_elapsed_ms;

		sent = zsock_sendto(sock,
				    tx_buf,
				    PAYLOAD_SIZE,
				    0,
				    (const struct sockaddr *)&peer_addr,
				    sizeof(peer_addr));

		if (sent < 0) {
			total_send_err++;
			window_send_err++;

			printk("sendto() failed: errno=%d\n", errno);

			/*
			 * Do not exit on transient failures.
			 * Keep the sender running so the remote node can observe
			 * whether traffic resumes after a short delay.
			 */
			k_sleep(K_MSEC(10));
		} else if ((size_t)sent != PAYLOAD_SIZE) {
			total_send_err++;
			window_send_err++;

			printk("partial send: sent=%d expected=%u\n",
			       (int)sent, PAYLOAD_SIZE);

			k_sleep(K_MSEC(10));
		} else {
			total_bytes += PAYLOAD_SIZE;
			total_pkts++;

			window_bytes += PAYLOAD_SIZE;
			window_pkts++;
		}

		now_ms = k_uptime_get();
		window_elapsed_ms = (uint64_t)(now_ms - window_start_ms);

		if (window_elapsed_ms >= 1000U) {
			uint64_t total_mbps_x100;
			uint64_t window_mbps_x100;

			total_elapsed_ms = (uint64_t)(now_ms - total_start_ms);

			if (total_elapsed_ms == 0U) {
				total_mbps_x100 = 0U;
			} else {
				total_mbps_x100 =
					(total_bytes * 8ULL * 100ULL) / total_elapsed_ms / 1000ULL;
			}

			window_mbps_x100 =
				(window_bytes * 8ULL * 100ULL) / window_elapsed_ms / 1000ULL;

			printk("app send loop: window_pkts=%llu window_bytes=%llu window_err=%llu "
			       "window=%llu.%02llu Mbps total_pkts=%llu total_bytes=%llu total_err=%llu "
			       "total=%llu.%02llu Mbps\n",
			       window_pkts,
			       window_bytes,
			       window_send_err,
			       window_mbps_x100 / 100ULL,
			       window_mbps_x100 % 100ULL,
			       total_pkts,
			       total_bytes,
			       total_send_err,
			       total_mbps_x100 / 100ULL,
			       total_mbps_x100 % 100ULL);

			window_bytes = 0U;
			window_pkts = 0U;
			window_send_err = 0U;
			window_start_ms = now_ms;
		}
	}

	/* Unreachable in the continuous sender path. */
	zsock_close(sock);
	return 0;
}
```

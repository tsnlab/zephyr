## CMakeLists.txt
```
# SPDX-License-Identifier: Apache-2.0

cmake_minimum_required(VERSION 3.20.0)
find_package(Zephyr REQUIRED HINTS $ENV{ZEPHYR_BASE})
project(t1s)

set(TICKLE_DIR ${CMAKE_CURRENT_LIST_DIR}/tickle)
set(TICKLE_INCLUDE_DIRS ${TICKLE_DIR}/include)
set(TICKLE_SOURCES
  ${TICKLE_DIR}/src/encoding.c
  ${TICKLE_DIR}/src/hal_zephyr.c
  ${TICKLE_DIR}/src/log.c
  ${TICKLE_DIR}/src/tickle.c
)

target_include_directories(app PRIVATE ${TICKLE_INCLUDE_DIRS})
target_sources(app PRIVATE src/main.c src/lan8651.c src/arp.c src/spi.c src/perf.c src/udp.c src/udp_perf.c ${TICKLE_SOURCES} src/pubsub/ping.c src/pubsub/pong.c src/pubsub/type/Perf.c)
```

## prj.conf
```kconfig
CONFIG_SPI=y
CONFIG_MAIN_STACK_SIZE=8192
```

## src/main.c
```c
#include <stdint.h>
#include <string.h>
#include <stdlib.h>
#include <errno.h>

#include <zephyr/drivers/spi.h>
#include <zephyr/drivers/uart.h>
#include <zephyr/sys/printk.h>
#include <zephyr/arch/cpu.h>

#include "eth.h"
#include "lan8651.h"
#include "arp.h"
#include "perf.h"
#include "udp.h"
#include "pubsub/pingpong.h"

#define UDP_ECHO_SERVER_PORT 0x0007
#define UDP_THROUGHPUT_SERVER_PORT 0x1337

#define THROUGHPUT_DURATION     10
#define THROUGHPUT_WARMUP       0
#define THROUGHPUT_PAYLOAD_SIZE 1500

#define T1S_PLCA_NODE_COUNT 0x08

#define SPI_NODE DT_ALIAS(spi0)

static const struct device *uart1 = DEVICE_DT_GET(DT_CHOSEN(zephyr_console));

struct spi_dt_spec spi_dev;

uint8_t my_mac_addr[ETH_ALEN];
uint8_t target_mac_addr[ETH_ALEN];
uint8_t my_ip_addr[IP_LEN];
uint8_t target_ip_addr[IP_LEN];

uint8_t tickle_node_id = 0;

static uint64_t get_cycle(void) {
	static int overflow_count = 0;
	static uint64_t last_sys_cycle = 0;
	uint64_t cycle = sys_clock_cycle_get_32();
	if (cycle < last_sys_cycle) {
		overflow_count++;
	}
	last_sys_cycle = cycle;
	return cycle + overflow_count * 0xFFFFFFFFULL;
}

static void print_help() {
	printk("Available commands:\n");
	printk("help\n");
	printk("t1s_init <node_id>\n");
	printk("udp_echo_client <source_port> <interval_ms>\n");
	printk("udp_echo_server\n");
	printk("udp_throughput_client <source_port> <duration_ms> <interval_us>\n");
	printk("udp_throughput_server\n");
	printk("tickle_ping\n");
	printk("tickle_pong\n");
}

static int parse_uint8(const char *str, uint8_t *out) {
	char *endptr;
	unsigned long val;

	if (str == NULL || *str == '\0') {
		return -1;
	}

	errno = 0;
	val = strtoul(str, &endptr, 10);

	if (errno != 0 || *endptr != '\0' || val > UINT8_MAX) {
		return -1;
	}

	*out = (uint8_t)val;
	return 0;
}

static int parse_uint16(const char *str, uint16_t *out) {
	char *endptr;
	unsigned long val;

	if (str == NULL || *str == '\0') {
		return -1;
	}

	errno = 0;
	val = strtoul(str, &endptr, 10);

	if (errno != 0 || *endptr != '\0' || val > UINT16_MAX) {
		return -1;
	}

	*out = (uint16_t)val;
	return 0;
}

static int parse_uint32(const char *str, uint32_t *out) {
	char *endptr;
	unsigned long val;

	if (str == NULL || *str == '\0') {
		return -1;
	}

	errno = 0;
	val = strtoul(str, &endptr, 10);

	if (errno != 0 || *endptr != '\0' || val > UINT32_MAX) {
		return -1;
	}

	*out = (uint32_t)val;
	return 0;
}

static void t1s_init(uint8_t node_id)
{
	printk("Initializing T1S\n");

	spi_dev.bus = DEVICE_DT_GET(SPI_NODE);
	spi_dev.config.frequency = 25000000;
	spi_dev.config.operation = SPI_OP_MODE_MASTER | SPI_WORD_SET(32) | SPI_HOLD_ON_CS;

	/* Set MAC Address */
	my_mac_addr[5] = node_id == 0x00 ? 0x00 : 0xFF;
	my_ip_addr[3] = node_id;

	/* Initialize T1S */
	set_register(&spi_dev, (uint16_t)T1S_PLCA_NODE_COUNT, node_id, my_mac_addr);

	printk("T1S initialized with node ID: %u(%s), MAC Address: %02x:%02x:%02x:%02x:%02x:%02x\n", node_id, node_id == 0 ? "coordinator" : "follower", 
		my_mac_addr[0], my_mac_addr[1], my_mac_addr[2], my_mac_addr[3], my_mac_addr[4], my_mac_addr[5]);
}

static void arp_test()
{
	// send_arp_request(&spi_dev, my_mac_addr, my_ip_addr, target_ip_addr);
	// receive_arp_reply(&spi_dev);
}

static void throughput_test()
{
	uint8_t payload[MAX_PERF_PAYLOAD] = {0};
	uint16_t len = 0;
	printk("Sending Perf Request to %02x:%02x:%02x:%02x:%02x:%02x\n", target_mac_addr[0], target_mac_addr[1], target_mac_addr[2], target_mac_addr[3], target_mac_addr[4], target_mac_addr[5]);
	// send_perf_req_packet(&spi_dev, my_mac_addr, target_mac_addr, THROUGHPUT_DURATION, THROUGHPUT_WARMUP);
	// while (true) {
	// 	send_perf_req_packet(&spi_dev, my_mac_addr, target_mac_addr, THROUGHPUT_DURATION, THROUGHPUT_WARMUP);	
	// 	k_busy_wait(100000);
	// }
	send_perf_req_packet(&spi_dev, my_mac_addr, target_mac_addr, THROUGHPUT_DURATION, THROUGHPUT_WARMUP);
	// len = make_perf_data_packet(my_mac_addr, target_mac_addr, payload, THROUGHPUT_PAYLOAD_SIZE);
	len = make_perf_data_packet(my_mac_addr, target_mac_addr, payload, THROUGHPUT_PAYLOAD_SIZE);
	struct ethhdr *eth = (struct ethhdr *)payload;
	struct perf_header *perf = (struct perf_header *)(eth + 1);
	uint32_t i = 0;
	int64_t start_time = k_uptime_get();
	while (true) {
		perf->id = sys_cpu_to_be32(i);
		send_perf_data_packet(&spi_dev, payload, len);
		i++;
		// k_busy_wait(1000000);
		// printk("%u\n", i);
		int64_t current_time = k_uptime_get();
		int64_t elapsed_time = current_time - start_time;
		if (elapsed_time > THROUGHPUT_DURATION * 1000) {
			printk("Throughput test finished\n");
			break;
		}
	}
	// while (true) {
	// 	perf->op = 0xff;
	// 	send_perf_data_packet(&spi_dev, payload, len);
	// }
}

static void latency_test()
{
	uint32_t id = 0;
	uint16_t len = 0;
	uint8_t payload[MAX_PERF_PAYLOAD] = {0};

	while (true) {
		while (id == 0) {
			recv_latency_req(&spi_dev, target_mac_addr, &id);
		}
		len = make_latency_res(payload, my_mac_addr, target_mac_addr, id);
		send_latency_res(&spi_dev, payload, len);
		id = 0;
	}
}

static void arp_receiver() {
	printk("ARP Receiver started\n");
	while (true) {
		receive_arp_request(&spi_dev, target_mac_addr, target_ip_addr);
	}
}

static void arp_sender() {
	printk("ARP Sender started\n");
	uint32_t seq = 0;
	while (true) {
		printk("Sending ARP Request to %d.%d.%d.%d\n", target_ip_addr[0], target_ip_addr[1], target_ip_addr[2], target_ip_addr[3]);
		uint64_t start_cycle = get_cycle();
		send_arp_request(&spi_dev, my_mac_addr, my_ip_addr, target_ip_addr, seq);
		receive_arp_reply(&spi_dev, &seq);
		uint64_t end_cycle = get_cycle();
		printk("Seq: %u, RTT: %llu ns\n", seq, (end_cycle - start_cycle) * 83);
		seq++;
		k_busy_wait(50000);
	}
}

static void perf_server() {
	printk("Perf Server started\n");

	uint8_t source_mac_addr[ETH_ALEN] = {0};
	uint32_t duration = 0;
	uint32_t warmup = 0;

	while (duration == 0) {
		recv_perf_req(&spi_dev, source_mac_addr, &duration, &warmup);
	}
	printk("Receiving from %02x:%02x:%02x:%02x:%02x:%02x\n", source_mac_addr[0], source_mac_addr[1], source_mac_addr[2], source_mac_addr[3], source_mac_addr[4], source_mac_addr[5]);
	// send_perf_res_packet(&spi_dev, target_mac_addr, source_mac_addr);

	uint64_t received_bits = 0;
	uint64_t received_packets = 0;
	uint32_t last_id = 0;
	uint64_t lost_packets = 0;

	int64_t start_time = k_uptime_get();
	// printk("Start time: %lld\n", start_time);

	uint32_t elapsed_seconds = 1;
	int ret = 0;
	while (true) {
		uint32_t len = 0;
		uint32_t id = 0;
		ret = recv_perf_data(&spi_dev, source_mac_addr, &id, &len);
		// if (ret == 0xff) {
		// 	printk("End of throughput test\n");
		// 	printk("Test duration: %d seconds\n", duration);
		// 	printk("Received %llu packets, %llu bytes\n", received_packets, received_bytes);
		// 	break;
		// }
		if (len != 0) {
			lost_packets += (id - last_id) - 1;
			last_id = id;
			received_bits += len * 8;
			received_packets++;
		}
			// printk("%u\n", id);

		int64_t current_time = k_uptime_get();
		int64_t elapsed_time = current_time - start_time;
		if (elapsed_time > 1000) {
			printk("%us: %lld pps, %lld bps, loss: %.2f%%\n", elapsed_seconds, received_packets, received_bits, ((double)lost_packets / (lost_packets + received_packets)) * 100);
			elapsed_seconds++;
			// if (elapsed_seconds > duration) {
			// 	break;
			// }
			start_time = current_time;
			received_bits = 0;
			received_packets = 0;
			lost_packets = 0;
		}
	}
}

static void udp_echo_client(uint16_t source_port, uint32_t interval_ms) {
	uint32_t send_seq = 0;
	uint8_t received_udp_src_mac_addr[ETH_ALEN] = {0};
	uint8_t received_udp_src_ip_addr[IP_LEN] = {0};
	uint16_t received_udp_src_port = 0;
	uint8_t received_data[12] = {0,};
	uint32_t received_data_length = 0;

	printk("UDP Echo Client started\n");

	while (true) {
		uint32_t start_clock = get_cycle();
		uint32_t end_clock;

		// Send UDP packet
		send_udp_packet(&spi_dev, my_mac_addr, my_ip_addr, 
								target_mac_addr, target_ip_addr, 
								source_port, UDP_ECHO_SERVER_PORT, 
								(uint8_t *)&send_seq, sizeof(send_seq));

		// Receive UDP packet
		while (received_data_length == 0) {
			receive_udp_packet(&spi_dev, received_udp_src_mac_addr, received_udp_src_ip_addr, &received_udp_src_port, 
									received_data, &received_data_length);
		}

		uint32_t received_seq = *(uint32_t *)received_data;
		if (received_seq != send_seq) {
			printk("Sequence number mismatch: expected %u, got %u\n", send_seq, received_seq);
			received_data_length = 0;
			continue;
		}

		end_clock = get_cycle();
		uint32_t total_rtt_ns = (end_clock - start_clock) * 83;
		printk("Seq [%u] Total RTT: %u ns, Oneway Latency: %u ns\n", send_seq, total_rtt_ns, total_rtt_ns / 2);

		k_busy_wait(interval_ms * 1000);
		send_seq++;

		received_data_length = 0;
	}
}

static void udp_echo_server() {
	uint8_t received_udp_src_mac_addr[ETH_ALEN] = {0};
	uint8_t received_udp_src_ip_addr[IP_LEN] = {0};
	uint16_t received_udp_src_port = 0;
	uint8_t received_data[12] = {0,};
	uint32_t received_data_length = 0;

	printk("UDP Echo Server started\n");

	while (true) {
		uint32_t process_start_clock, process_end_clock;
		uint32_t send_start_clock, send_end_clock;
		uint32_t total_start_clock, total_end_clock;

		// Receive UDP packet
		while (received_data_length == 0) {
			receive_udp_packet(&spi_dev, received_udp_src_mac_addr, received_udp_src_ip_addr, &received_udp_src_port, 
									received_data, &received_data_length);
		}

		total_start_clock = get_cycle();

		// Process received data
		process_start_clock = get_cycle();
		uint32_t received_seq = *(uint32_t *)received_data;
		process_end_clock = get_cycle();
		uint32_t process_time_ns = (process_end_clock - process_start_clock) * 83;

		// Send response UDP packet
		send_start_clock = get_cycle();
		send_udp_packet(&spi_dev, my_mac_addr, my_ip_addr, 
								received_udp_src_mac_addr, received_udp_src_ip_addr, 
								UDP_ECHO_SERVER_PORT, received_udp_src_port, 
								(uint8_t *)&received_seq, sizeof(received_seq));
		send_end_clock = get_cycle();
		uint32_t send_time_ns = (send_end_clock - send_start_clock) * 83;

		total_end_clock = get_cycle();
		uint32_t total_time_ns = (total_end_clock - total_start_clock) * 83;

		printk("[Seq %u] Total: %u ns (send: %u ns, process: %u ns)\n",
		       received_seq, total_time_ns, send_time_ns, process_time_ns);

		received_data_length = 0;
	}
}

static void udp_throughput_client(uint16_t source_port, uint32_t duration_ms, uint32_t interval_us) {
	printk("UDP Throughput Client started\n");
	
	uint8_t packet[MAX_PERF_PAYLOAD] = {0};
	uint16_t udp_packet_length = 0;
	uint32_t perf_id = 0;

	/* Send Perf Request */
	udp_packet_length = make_udp_packet(packet, my_mac_addr, my_ip_addr, 
								target_mac_addr, target_ip_addr, 
								source_port, UDP_THROUGHPUT_SERVER_PORT, 
								NULL, 0);
	make_udp_perf_req_packet(packet + udp_packet_length, duration_ms, 0);
	send_udp_perf_req_packet(&spi_dev, packet, sizeof(packet));

	printk("Waiting for server to initialize\n");
    uint32_t wait_server_init_time_ms = 1000 * 1000; // 1 second
    k_busy_wait(wait_server_init_time_ms);

	/* Send Perf Data */
	udp_packet_length = make_udp_packet(packet, my_mac_addr, my_ip_addr, 
		target_mac_addr, target_ip_addr, 
		source_port, UDP_THROUGHPUT_SERVER_PORT, 
		NULL, 0);
	make_udp_perf_data_packet(packet + udp_packet_length);

	struct ethhdr *eth = (struct ethhdr *)packet;
	struct ipv4hdr *ipv4 = (struct ipv4hdr *)(eth + 1);
	struct udphdr *udp = (struct udphdr *)(ipv4 + 1);
	struct perf_header *perf = (struct perf_header *)(udp + 1);

	int64_t start_time = k_uptime_get();
	while(true) {
		perf->id = sys_cpu_to_be32(perf_id);
		send_udp_perf_data_packet(&spi_dev, packet, sizeof(packet));
		perf_id++;
		int64_t current_time = k_uptime_get();
		int64_t elapsed_time = current_time - start_time;
		if (elapsed_time > duration_ms) {
			break;
		}

		/* Transmission Interval Adjustment */
		k_busy_wait(interval_us);
	}

	printk("UDP Throughput Client finished\n");
}

static void udp_throughput_server() {
	printk("UDP Throughput Server started\n");

	uint8_t source_mac_addr[ETH_ALEN] = {0};
	uint8_t source_ip_addr[IP_LEN] = {0};
	uint16_t source_port = 0;
	uint32_t requested_duration_ms = 0;
	
	while (requested_duration_ms == 0) {
		recv_udp_perf_req(&spi_dev, source_mac_addr, source_ip_addr, &source_port, &requested_duration_ms);
	}
	printk("Receiving from %02x:%02x:%02x:%02x:%02x:%02x (%d.%d.%d.%d:%d)\n", 
		source_mac_addr[0], source_mac_addr[1], source_mac_addr[2], source_mac_addr[3], source_mac_addr[4], source_mac_addr[5], 
		source_ip_addr[0], source_ip_addr[1], source_ip_addr[2], source_ip_addr[3], source_port);

	uint64_t received_bits = 0;
	uint64_t received_packets = 0;
	uint32_t last_id = 0;
	uint64_t lost_packets = 0;

	int64_t start_time = k_uptime_get();

	uint32_t elapsed_seconds = 1;
	int received_length = 0;
	while (true) {
		uint32_t id = 0;
		received_length = recv_udp_perf_data(&spi_dev, source_port, &id);
		if (received_length != 0) {
			lost_packets += (id - last_id) - 1;
			last_id = id;
			received_bits += received_length * 8;
			received_packets++;
		}

		int64_t current_time = k_uptime_get();
		int64_t elapsed_time = current_time - start_time;
		if (elapsed_time > 1000) {
			printk("%us: %lld pps, %lld bps\n", elapsed_seconds, 
				received_packets, received_bits);
			elapsed_seconds++;
			start_time = current_time;
			received_bits = 0;
			received_packets = 0;
			lost_packets = 0;
		}
	}

	printk("UDP Throughput Server finished\n");
}

int main(void)
{
	char command_buffer[64] = {0};
	char command_char = '\0';
	int index = 0;

	if (!device_is_ready(uart1)) {
		printk("Error: UART %s is not ready\n", uart1->name);
		return -1;
	}

	memcpy(my_mac_addr, (const uint8_t[]){0xCC, 0x00, 0xFF, 0xEE, 0x00, 0x00}, ETH_ALEN);
	memcpy(my_ip_addr, (const uint8_t[]){10, 1, 1, 0}, IP_LEN);
	memcpy(target_mac_addr, (const uint8_t[]){0xCC, 0x00, 0xFF, 0xEE, 0x00, 0xFF}, ETH_ALEN);
	memcpy(target_ip_addr, (const uint8_t[]){10, 1, 1, 255}, IP_LEN);

	printk("Ready\n");

	while(1) {

		/* Read Command */
		index = 0;
		memset(command_buffer, '\0', sizeof(command_buffer));

		while (index < (sizeof(command_buffer) - 1)) {
			int ret = uart_poll_in(uart1, &command_char);
			if (ret == 0) {
				if (command_char == '\n' || command_char == '\r') {
					break;
				}
				if (index == (sizeof(command_buffer) - 1)) {
					printk("Command buffer is full: %s\n", command_buffer);
					break;
				}

				command_buffer[index++] = command_char;
			}
		}
		
		command_buffer[index] = '\0';
		if (index > 0) {
			printk("Command: %s\n", command_buffer);
		}

		/* Process Command */
		if (strcmp(command_buffer, "help") == 0) {
			print_help();
		} else if (strncmp(command_buffer, "t1s_init", strlen("t1s_init")) == 0) {
			char *arg_start = command_buffer + strlen("t1s_init");
			uint8_t node_id = 0;

			// Skip whitespace
			while (*arg_start == ' ' || *arg_start == '\t') {
				arg_start++;
			}

			if (*arg_start == '\0') {
				printk("Error: t1s_init requires node_id argument\n");
				continue;
			}

			// Parse node_id
			if (parse_uint8(arg_start, &node_id) != 0) {
				printk("Error: Invalid node_id format. Expected a number (0-255)\n");
				continue;
			}

			t1s_init(node_id);
			tickle_node_id = (node_id == 255 ? 0: node_id + 1);
		} else if (strncmp(command_buffer, "udp_echo_client", strlen("udp_echo_client")) == 0) {
			char *arg_start = command_buffer + strlen("udp_echo_client");
			char *token;
			char *saveptr;
			uint16_t source_port = 0;
			uint32_t interval_ms = 0;

			// Skip whitespace
			while (*arg_start == ' ' || *arg_start == '\t') {
				arg_start++;
			}

			if (*arg_start == '\0') {
				printk("Error: udp_echo_client requires source_port and interval_ms arguments\n");
				continue;
			}

			// Parse first argument (source_port)
			token = strtok_r(arg_start, " \t", &saveptr);
			if (token == NULL || parse_uint16(token, &source_port) != 0) {
				printk("Error: Invalid source_port format\n");
				continue;
			}

			// Parse second argument (interval_ms)
			token = strtok_r(NULL, " \t", &saveptr);
			if (token == NULL || parse_uint32(token, &interval_ms) != 0) {
				printk("Error: Invalid interval_ms format\n");
				continue;
			}

			udp_echo_client(source_port, interval_ms);
		} else if (strcmp(command_buffer, "udp_echo_server") == 0) {
			udp_echo_server();
		} else if (strncmp(command_buffer, "udp_throughput_client", strlen("udp_throughput_client")) == 0) {
			char *arg_start = command_buffer + strlen("udp_throughput_client");
			char *token;
			char *saveptr;
			uint16_t source_port = 0;
			uint32_t duration_ms = 0;
			uint32_t interval_us = 0;

			// Skip whitespace
			while (*arg_start == ' ' || *arg_start == '\t') {
				arg_start++;
			}

			if (*arg_start == '\0') {
				printk("Error: udp_throughput_client requires source_port and duration_ms arguments\n");
				continue;
			}

			// Parse first argument (source_port)
			token = strtok_r(arg_start, " \t", &saveptr);
			if (token == NULL || parse_uint16(token, &source_port) != 0) {
				printk("Error: Invalid source_port format\n");
				continue;
			}

			// Parse second argument (duration_ms)
			token = strtok_r(NULL, " \t", &saveptr);
			if (token == NULL || parse_uint32(token, &duration_ms) != 0) {
				printk("Error: Invalid duration_ms format\n");
				continue;
			}

			// Parse third argument (interval_us)
			token = strtok_r(NULL, " \t", &saveptr);
			if (token == NULL || parse_uint32(token, &interval_us) != 0) {
				printk("Error: Invalid duration_ms format\n");
				continue;
			}

			udp_throughput_client(source_port, duration_ms, interval_us);
		} else if (strcmp(command_buffer, "udp_throughput_server") == 0) {
			udp_throughput_server();
		} else if (strcmp(command_buffer, "tickle_ping") == 0) {
			ping_main();
		} else if (strcmp(command_buffer, "tickle_pong") == 0) {
			pong_main();
		} else {
			printk("Unknown command: %s\n", command_buffer);
		}
	}

	return 0;
}
```

## src/arp.c
```c
#include <stdint.h>

#include <zephyr/drivers/spi.h>
#include <zephyr/sys/byteorder.h>
#include <zephyr/sys/printk.h>

#include "eth.h"
#include "lan8651.h"

static uint16_t make_arp_request_packet(uint8_t *packet, const uint8_t my_mac_addr[ETH_ALEN],
					const uint8_t my_ip_addr[IP_LEN],
					const uint8_t target_ip_addr[IP_LEN])
{

	struct ethhdr *eth = (struct ethhdr *)packet;
	struct arphdr_ipv4 *arp = (struct arphdr_ipv4 *)(eth + 1);

	// Fill Ethernet header
	memset(eth->h_dest, 0xFF, ETH_ALEN); // Broadcast
	memcpy(eth->h_source, my_mac_addr, ETH_ALEN);
	eth->h_proto = sys_cpu_to_be16(ETH_P_ARP);

	// Fill ARP header
	arp->arp.ar_hrd = sys_cpu_to_be16(1);
	arp->arp.ar_pro = sys_cpu_to_be16(ETH_P_IP);
	arp->arp.ar_hln = ETH_ALEN;
	arp->arp.ar_pln = IP_LEN;
	arp->arp.ar_op = sys_cpu_to_be16(ARPOP_REQUEST);
	memcpy(arp->sender_mac, my_mac_addr, ETH_ALEN);
	memcpy(arp->sender_ip, my_ip_addr, IP_LEN);
	memset(arp->target_mac, 0x00, ETH_ALEN); // Unknown
	memcpy(arp->target_ip, target_ip_addr, IP_LEN);

	return PACKET_SIZE_ARP;
}

int send_arp_request(const struct spi_dt_spec *spi, const uint8_t my_mac_addr[ETH_ALEN],
		     const uint8_t my_ip_addr[IP_LEN], const uint8_t target_ip_addr[IP_LEN])
{
	uint8_t packet[PACKET_SIZE_ARP];
	uint16_t length = make_arp_request_packet(packet, my_mac_addr, my_ip_addr, target_ip_addr);

	return send_packet(spi, packet, length);
}

int receive_arp_reply(const struct spi_dt_spec *spi)
{
	uint8_t packet[MAX_PACKET_SIZE] = {
		0,
	};
	uint16_t length = 0;

	while (length == 0) {
		if (receive_packet(spi, packet, &length) < 0) {
			printk("Failed to receive ARP reply\n");
			return -1;
		}
	}

	struct ethhdr *eth = (struct ethhdr *)packet;
	struct arphdr_ipv4 *arp = (struct arphdr_ipv4 *)(eth + 1);

	if (eth->h_proto != sys_cpu_to_be16(ETH_P_ARP)) {
		printk("Invalid ARP packet\n");
	}

	if (arp->arp.ar_op != sys_cpu_to_be16(ARPOP_REPLY)) {
		printk("Invalid ARP reply\n");
		return -1;
	}

	printk("ARP Request: \n");
	printk("=== Ethernet Header ===\n");
	printk("Destination MAC: %02x:%02x:%02x:%02x:%02x:%02x\n", packet[0], packet[1], packet[2],
	       packet[3], packet[4], packet[5]);
	printk("Source MAC: %02x:%02x:%02x:%02x:%02x:%02x\n", packet[6], packet[7], packet[8],
	       packet[9], packet[10], packet[11]);

	uint16_t tx_ethertype = (packet[12] << 8) | packet[13];
	printk("EtherType: 0x%04x (%s)\n", tx_ethertype,
	       tx_ethertype == 0x0806 ? "ARP" : "Unknown");

	printk("\n=== ARP Header ===\n");
	uint16_t tx_hw_type = (packet[14] << 8) | packet[15];
	printk("Hardware Type: 0x%04x (%s)\n", tx_hw_type,
	       tx_hw_type == 0x0001 ? "Ethernet" : "Unknown");

	uint16_t tx_proto_type = (packet[16] << 8) | packet[17];
	printk("Protocol Type: 0x%04x (%s)\n", tx_proto_type,
	       tx_proto_type == 0x0800 ? "IPv4" : "Unknown");

	uint8_t tx_hw_size = packet[18];
	uint8_t tx_proto_size = packet[19];
	printk("Hardware Size: %d bytes\n", tx_hw_size);
	printk("Protocol Size: %d bytes\n", tx_proto_size);

	uint16_t tx_operation = (packet[20] << 8) | packet[21];
	printk("Operation: 0x%04x (%s)\n", tx_operation,
	       tx_operation == 0x0001   ? "Request"
	       : tx_operation == 0x0002 ? "Reply"
					: "Unknown");

	printk("\nSender MAC: %02x:%02x:%02x:%02x:%02x:%02x\n", packet[22], packet[23], packet[24],
	       packet[25], packet[26], packet[27]);
	printk("Sender IP: %d.%d.%d.%d\n", packet[28], packet[29], packet[30], packet[31]);

	printk("Target MAC: %02x:%02x:%02x:%02x:%02x:%02x\n", packet[32], packet[33], packet[34],
	       packet[35], packet[36], packet[37]);
	printk("Target IP: %d.%d.%d.%d\n", packet[38], packet[39], packet[40], packet[41]);

	return 0;
}
```

## src/arp.h
```c
#ifndef ARP_H
#define ARP_H

#include <stdint.h>

#include <zephyr/drivers/spi.h>
#include <zephyr/sys/byteorder.h>
#include <zephyr/sys/printk.h>

#include "eth.h"

int send_arp_request(const struct spi_dt_spec *spi, const uint8_t my_mac_addr[ETH_ALEN],
		     const uint8_t my_ip_addr[IP_LEN], const uint8_t target_ip_addr[IP_LEN], uint32_t seq);
int send_arp_reply(const struct spi_dt_spec *spi, const uint8_t my_mac_addr[ETH_ALEN],
		     const uint8_t my_ip_addr[IP_LEN], const uint8_t target_mac_addr[ETH_ALEN],
		     const uint8_t target_ip_addr[IP_LEN], uint32_t seq);
int receive_arp_reply(const struct spi_dt_spec *spi, uint32_t *seq);
int receive_arp_request(const struct spi_dt_spec *spi, const uint8_t my_mac_addr[ETH_ALEN],
		     const uint8_t my_ip_addr[IP_LEN]);

#endif /* ARP_H */
```

## src/eth.h
```c
#ifndef ETH_H
#define ETH_H

#include <stdint.h>

/* FIXME: These are borrowed from linux headers since network features are not available */
/* Remove this file and use the one included in Zephyr after the issue's fixed */

#define IP_LEN          (4)
#define PACKET_SIZE_ARP (sizeof(struct ethhdr) + sizeof(struct arphdr_ipv4))

#define ETH_ALEN 6
#define ETH_HLEN 14
#define ARP_HLEN 28

#define ETH_P_IP  0x0800 /* Internet Protocol packet	*/
#define ETH_P_ARP 0x0806 /* Address Resolution packet	*/
#define IPPROTO_UDP 0x11 /* User Datagram Protocol	*/

#define ARPOP_REQUEST 1 /* ARP request.  */
#define ARPOP_REPLY   2 /* ARP reply.  */

#define PF_INET 2 /* IP protocol family.  */
#define AF_INET PF_INET

struct ethhdr {
	unsigned char h_dest[ETH_ALEN];   /* destination eth addr	*/
	unsigned char h_source[ETH_ALEN]; /* source ether addr	*/
	uint16_t h_proto;                 /* packet type ID field	*/
} __attribute__((packed));

struct ethhdr_l {
	unsigned char h_dest[ETH_ALEN];
	unsigned char h_source[ETH_ALEN];
	unsigned short h_proto;
};

struct arphdr_l {
	unsigned short ar_hrd;
	unsigned short ar_pro;
	unsigned char ar_hln;
	unsigned char ar_pln;
	unsigned short ar_op;
	unsigned char ar_sha[ETH_ALEN];
	unsigned char ar_sip[4];
	unsigned char ar_tha[ETH_ALEN];
	unsigned char ar_tip[4];
};

struct arphdr {
	unsigned short int ar_hrd; /* Format of hardware address.  */
	unsigned short int ar_pro; /* Format of protocol address.  */
	unsigned char ar_hln;      /* Length of hardware address.  */
	unsigned char ar_pln;      /* Length of protocol address.  */
	unsigned short int ar_op;  /* ARP opcode (command).  */
};

struct arphdr_ipv4 {
	struct arphdr arp;
	uint8_t sender_mac[ETH_ALEN];
	uint8_t sender_ip[IP_LEN];
	uint8_t target_mac[ETH_ALEN];
	uint8_t target_ip[IP_LEN];
	uint32_t seq;
};

// ARP table entry regarding IPv4
struct arp_entry {
	uint8_t ip[IP_LEN];
	uint8_t mac[ETH_ALEN];
};

struct ipv4hdr {
	/* TODO: check endianness */
	uint8_t ihl:4;
	uint8_t version:4;
	uint8_t tos;
	uint16_t len;
	uint16_t id;
	uint16_t frag_off;
	uint8_t ttl;
	uint8_t proto;
	uint16_t chksum;
	uint32_t src;
	uint32_t dst;
} __attribute__((packed));

struct udphdr {
	uint16_t source_port;
	uint16_t dest_port;
	uint16_t length;
	uint16_t checksum;
} __attribute__((packed));

#endif /* ETH_H */
```

## src/lan8651.c
```c
#include <stdint.h>

#include <zephyr/drivers/spi.h>
#include <zephyr/sys/byteorder.h>
#include <zephyr/sys/printk.h>

#include "lan8651.h"
#include "spi.h"

/* FIXME: These are borrowed from our T1S demo */

uint8_t get_parity(uint32_t valueToCalculateParity)
{
	valueToCalculateParity &= 0xFFFFFFFE;
	valueToCalculateParity ^= valueToCalculateParity >> 1;
	valueToCalculateParity ^= valueToCalculateParity >> 2;
	valueToCalculateParity = ((valueToCalculateParity & 0x11111111) * 0x11111111);
	return !((valueToCalculateParity >> 28) & 1);
}

static bool t1s_hw_readreg(const struct spi_dt_spec *spi_dev, struct ctrl_cmd_reg *p_regInfoInput,
			   struct ctrl_cmd_reg *p_readRegData)
{
	const uint8_t ignored_echoedbytes = HEADER_SIZE;
	bool readstatus = false;
	uint8_t txbuffer[MAX_REG_DATA_ONECONTROLCMD + HEADER_SIZE + REG_SIZE] = {0};
	uint8_t rxbuffer[MAX_REG_DATA_ONECONTROLCMD + HEADER_SIZE + REG_SIZE] = {0};
	uint16_t numberof_bytestosend = 0;
	union ctrl_header commandheader;
	union ctrl_header commandheader_echoed;
	uint32_t converted_commandheader;

	commandheader.ctrl_frame_head = 0;
	commandheader_echoed.ctrl_frame_head = 0;
	commandheader.ctrl_head_bits.dnc = DNC_COMMANDTYPE_CONTROL;
	commandheader.ctrl_head_bits.hdrb = 0;
	commandheader.ctrl_head_bits.wnr = REG_COMMAND_TYPE_READ; // Read from register
	if (p_regInfoInput->length != 0) {
		commandheader.ctrl_head_bits.aid =
			REG_ADDR_INCREMENT_ENABLE; // Read register continously from given address
	} else {
		commandheader.ctrl_head_bits.aid =
			REG_ADDR_INCREMENT_DISABLE; // Read from same register
	}
	commandheader.ctrl_head_bits.mms = (uint32_t)p_regInfoInput->memorymap;
	commandheader.ctrl_head_bits.addr = (uint32_t)p_regInfoInput->address;
	commandheader.ctrl_head_bits.len = (uint32_t)(p_regInfoInput->length & 0x7F);
	commandheader.ctrl_head_bits.p = 0;
	commandheader.ctrl_head_bits.p = get_parity(commandheader.ctrl_frame_head);

	converted_commandheader = sys_cpu_to_be32(commandheader.ctrl_frame_head);
	memcpy(txbuffer, &converted_commandheader, HEADER_SIZE);

	numberof_bytestosend = HEADER_SIZE + ((commandheader.ctrl_head_bits.len + 1) * REG_SIZE) +
			       ignored_echoedbytes; // Added extra 4 bytes because first 4 bytes
						    // during reception shall be ignored

	transceive(txbuffer, rxbuffer, numberof_bytestosend);

	memcpy((uint8_t *)&commandheader_echoed.ctrl_frame_head, &rxbuffer[ignored_echoedbytes],
	       HEADER_SIZE);
	commandheader_echoed.ctrl_frame_head =
		sys_be32_to_cpu(commandheader_echoed.ctrl_frame_head);

	if (commandheader_echoed.ctrl_head_bits.hdrb !=
	    1) // if MACPHY received header with parity error then it will be 1
	{
		if (commandheader.ctrl_head_bits.len == 0) {
			memcpy((uint8_t *)&p_readRegData->databuffer[0],
			       &(rxbuffer[ignored_echoedbytes + HEADER_SIZE]), REG_SIZE);
			p_readRegData->databuffer[0] =
				sys_be32_to_cpu(p_readRegData->databuffer[0]);
		} else {
			for (int regCount = 0; regCount <= commandheader.ctrl_head_bits.len;
			     regCount++) {
				memcpy((uint8_t *)&p_readRegData->databuffer[regCount],
				       &rxbuffer[ignored_echoedbytes + HEADER_SIZE +
						 (REG_SIZE * regCount)],
				       REG_SIZE);
				p_readRegData->databuffer[regCount] =
					sys_be32_to_cpu(p_readRegData->databuffer[regCount]);
			}
		}
		readstatus = true;
	} else {
		// TODO: Error handling if MACPHY received with header parity error
		printk("Parity Error READMACPHYReg header value : 0x%08x\n",
		       commandheader_echoed.ctrl_frame_head);
	}

	return readstatus;
}

static bool t1s_hw_writereg(const struct spi_dt_spec *spi_dev, struct ctrl_cmd_reg *p_regData)
{
	uint8_t numberof_bytestosend = 0;
	uint8_t numberof_registerstosend = 0;
	bool writestatus = true;
	bool execution_status = false;
	const uint8_t ignored_echoedbytes = HEADER_SIZE;
	uint8_t txbuffer[MAX_PAYLOAD_BYTE + HEADER_SIZE] = {0};
	uint8_t rxbuffer[MAX_PAYLOAD_BYTE + HEADER_SIZE] = {0};
	union ctrl_header commandheader;
	union ctrl_header commandheader_echoed;
	uint32_t converted_commandheader;

	commandheader.ctrl_frame_head = commandheader_echoed.ctrl_frame_head = 0;

	commandheader.ctrl_head_bits.dnc = DNC_COMMANDTYPE_CONTROL;
	commandheader.ctrl_head_bits.hdrb = 0;
	commandheader.ctrl_head_bits.wnr = REG_COMMAND_TYPE_WRITE; // Write into register
	if (p_regData->length != 0) {
		commandheader.ctrl_head_bits.aid =
			REG_ADDR_INCREMENT_ENABLE; // Write register continously from given address
	} else {
		commandheader.ctrl_head_bits.aid =
			REG_ADDR_INCREMENT_DISABLE; // Write into same register
	}
	commandheader.ctrl_head_bits.mms = (uint32_t)(p_regData->memorymap & 0x0F);
	commandheader.ctrl_head_bits.addr = (uint32_t)p_regData->address;
	commandheader.ctrl_head_bits.len = (uint32_t)(p_regData->length & 0x7F);
	commandheader.ctrl_head_bits.p = 0;
	commandheader.ctrl_head_bits.p = get_parity(commandheader.ctrl_frame_head);

	converted_commandheader = sys_cpu_to_be32(commandheader.ctrl_frame_head);
	memcpy(txbuffer, &converted_commandheader, HEADER_SIZE);

	numberof_registerstosend = commandheader.ctrl_head_bits.len + 1;
	for (uint8_t controlRegIndex = 0; controlRegIndex < numberof_registerstosend;
	     controlRegIndex++) {
		uint32_t data = sys_cpu_to_be32(p_regData->databuffer[controlRegIndex]);
		memcpy(&txbuffer[HEADER_SIZE + controlRegIndex * REG_SIZE], &data,
		       sizeof(uint32_t));
	}

	numberof_bytestosend = HEADER_SIZE + ((commandheader.ctrl_head_bits.len + 1) * REG_SIZE) +
			       ignored_echoedbytes; // Added extra 4 bytes because last 4 bytes of
						    // payload will be ignored by MACPHY

	transceive(txbuffer, rxbuffer, numberof_bytestosend);

	memcpy((uint8_t *)&commandheader_echoed.ctrl_frame_head, &rxbuffer[ignored_echoedbytes],
	       HEADER_SIZE);
	commandheader_echoed.ctrl_frame_head =
		sys_be32_to_cpu(commandheader_echoed.ctrl_frame_head);
	// TODO: check this logic and modify it if needed
	if (commandheader.ctrl_head_bits.mms == 0) {
		struct ctrl_cmd_reg readreg_infoinput;
		struct ctrl_cmd_reg readreg_data;

		// Reads CONFIG0 register from MMS 0
		readreg_infoinput.memorymap = MMS0;
		readreg_infoinput.length = 0;
		readreg_infoinput.address = OA_CONFIG0;
		memset(&readreg_infoinput.databuffer[0], 0, MAX_REG_DATA_ONECHUNK);

		execution_status = t1s_hw_readreg(spi_dev, &readreg_infoinput, &readreg_data);
		if (execution_status == false) {
			printk("Reading CONFIG0 reg failed after writing (inside WriteReg)\n");
		} else {
			// printk("CONFIG0 reg value is 0x%08x in WriteReg function\n", readreg_data.databuffer[0]);
		}
	}

	return writestatus;
}

uint32_t write_register(const struct spi_dt_spec *spi_dev, uint8_t mms, uint16_t address,
			uint32_t data)
{
	struct ctrl_cmd_reg writereg_input;
	bool execution_status = false;
	writereg_input.memorymap = mms;
	writereg_input.length = 0;
	writereg_input.address = address;
	writereg_input.databuffer[0] = data;

	execution_status = t1s_hw_writereg(spi_dev, &writereg_input);
	if (execution_status == true) {
		return writereg_input.databuffer[0];
	} else {
		printk("ERROR: Register Write failed at MMS %d, Address %4x\n", mms, address);
		return 0;
	}
}

uint32_t read_register(const struct spi_dt_spec *spi_dev, uint8_t mms, uint16_t address)
{
	bool execution_status = false;
	struct ctrl_cmd_reg readreg_infoinput;
	struct ctrl_cmd_reg readreg_data;
	readreg_infoinput.memorymap = mms;
	readreg_infoinput.length = 0;
	readreg_infoinput.address = address;

	execution_status = t1s_hw_readreg(spi_dev, &readreg_infoinput, &readreg_data);
	if (execution_status == true) {
		return readreg_data.databuffer[0];
	} else {
		printk("ERROR: Register Read failed at MMS %d, Address %4x\n", mms, address);
		return 0;
	}
}

static void set_macphy_register(const struct spi_dt_spec *spi_dev)
{
	uint8_t value1 = read_register(spi_dev, 0x04, 0x1F);
	int8_t offset1;
	if ((value1 & 0x10) != 0) {
		offset1 = (int8_t)((uint8_t)value1 - 0x20);
	} else {
		offset1 = (int8_t)value1;
	}

	uint8_t value2 = read_register(spi_dev, 0x08, 0x1F);
	int8_t offset2;
	if ((value2 & 0x10) != 0) {
		offset2 = (int8_t)((uint8_t)value2 - 0x20);
	} else {
		offset2 = (int8_t)value2;
	}

	uint16_t cfgparam1 = (uint16_t)(((9 + offset1) & 0x3F) << 10) |
			     (uint16_t)(((14 + offset1) & 0x3F) << 4) | 0x03;
	uint16_t cfgparam2 = (uint16_t)(((40 + offset2) & 0x3F) << 10);

	write_register(spi_dev, MMS4, 0x00D0, 0x3F31);
	write_register(spi_dev, MMS4, 0x00E0, 0xC000);
	write_register(spi_dev, MMS4, 0x0084, cfgparam1);
	write_register(spi_dev, MMS4, 0x008A, cfgparam2);
	write_register(spi_dev, MMS4, 0x00E9, 0x9E50);
	write_register(spi_dev, MMS4, 0x00F5, 0x1CF8);
	write_register(spi_dev, MMS4, 0x00F4, 0xC020);
	write_register(spi_dev, MMS4, 0x00F8, 0xB900);
	write_register(spi_dev, MMS4, 0x00F9, 0x4E53);
	write_register(spi_dev, MMS4, 0x0081, 0x0080);
	write_register(spi_dev, MMS4, 0x0091, 0x9660);
	write_register(spi_dev, MMS4, 0x0077, 0x0028);
	write_register(spi_dev, MMS4, 0x0043, 0x00FF);
	write_register(spi_dev, MMS4, 0x0044, 0xFFFF);
	write_register(spi_dev, MMS4, 0x0045, 0x0000);
	write_register(spi_dev, MMS4, 0x0053, 0x00FF);
	write_register(spi_dev, MMS4, 0x0054, 0xFFFF);
	write_register(spi_dev, MMS4, 0x0055, 0x0000);
	write_register(spi_dev, MMS4, 0x0040, 0x0002);
	write_register(spi_dev, MMS4, 0x0050, 0x0002);
}

int set_register(const struct spi_dt_spec *spi_dev, uint8_t node_count, uint8_t node_id, const uint8_t* mac_address)
{
	uint32_t regval;

	/* Read OA_STATUS0 */
	regval = read_register(spi_dev, MMS0, OA_STATUS0);
	printk("OA_STATUS0: 0x%08x\n", regval);

	/* Write 1 to RESETC bit of OA_STATUS0 */
	regval |= (1 << 6);
	write_register(spi_dev, MMS0, OA_STATUS0, regval);
	printk("OA_STATUS0: 0x%08x\n", regval);

	regval = read_register(spi_dev, MMS4, CDCTL0);
	write_register(spi_dev, MMS4, CDCTL0,
		       regval | (1 << 15)); // Initial logic (disable collision detection)
	printk("CDCTL0: 0x%08x\n", regval);

	// PLCA Configuration based on mode
	// TODO: This process is temporary and assumes that there are only two nodes.
	// TODO: Should be changed to get node info. from the command line.
	
	write_register(spi_dev, MMS4, PLCA_CTRL1,
				((uint32_t)node_id) | ((uint32_t)node_count << 8));
	write_register(spi_dev, MMS1, MAC_SAB1,
				((uint32_t)*(mac_address + 0)) | ((uint32_t)*(mac_address + 1) << 8) |
				((uint32_t)*(mac_address + 2) << 16) | ((uint32_t)*(mac_address + 3) << 24));
	write_register(spi_dev, MMS1, MAC_SAT1,
				((uint32_t)*(mac_address + 4)) | ((uint32_t)*(mac_address + 5) << 8));
	printk("PLCA_CTRL1: 0x%08x\n", read_register(spi_dev, MMS4, PLCA_CTRL1));
	printk("MAC_SAB1: 0x%08x\n", read_register(spi_dev, MMS1, MAC_SAB1));
	printk("MAC_SAT1: 0x%08x\n", read_register(spi_dev, MMS1, MAC_SAT1));

	set_macphy_register(spi_dev); // AN_LAN865x-Configuration

	write_register(spi_dev, MMS4, PLCA_CTRL0, 0x00008000); // Enable PLCA
	write_register(spi_dev, MMS1, MAC_NCFGR, 0x000000C0);  // Enable unicast, multicast
	write_register(spi_dev, MMS1, MAC_NCR, 0x0000000C);    // Enable MACPHY TX, RX
	printk("PLCA_CTRL0: 0x%08x\n", read_register(spi_dev, MMS4, PLCA_CTRL0));
	printk("MAC_NCFGR: 0x%08x\n", read_register(spi_dev, MMS1, MAC_NCFGR));
	printk("MAC_NCR: 0x%08x\n", read_register(spi_dev, MMS1, MAC_NCR));

	/* Read OA_CONFIG0 */
	regval = read_register(spi_dev, MMS0, OA_CONFIG0);
	printk("OA_CONFIG0: 0x%08x\n", regval);

	/* Set SYNC bit of OA_CONFIG0 */
	regval |= (1 << 15);
	regval &= ~(0x7);
	regval |= (0x6);
	write_register(spi_dev, MMS0, OA_CONFIG0, regval);
	printk("OA_CONFIG0: 0x%08x\n", regval);

	/* Read OA_STATUS0 */
	regval = read_register(spi_dev, MMS0, OA_STATUS0);
	printk("OA_STATUS0: 0x%08x\n", regval);

	/* Clear RESETC bit of OA_STATUS0 */
	regval &= ~(1UL << 6);
	write_register(spi_dev, MMS0, OA_STATUS0, regval);
	printk("OA_STATUS0: 0x%08x\n", regval);

	return true;
}

int send_packet(const struct spi_dt_spec *spi_dev, const uint8_t *data, uint16_t length)
{
	if (length > MAX_PACKET_SIZE) {
		printk("Packet size is too large: %d\n", length);
		return -1;
	}

	uint8_t tx_buffer[HEADER_SIZE + MAX_PAYLOAD_BYTE] = {0};
	uint8_t rx_buffer[MAX_PAYLOAD_BYTE + FOOTER_SIZE] = {0};

	union data_header header;
	uint32_t be_header;

	uint32_t chunk_count = length / MAX_PAYLOAD_BYTE;
	if (length % 64) {
		chunk_count++;
	}

	uint32_t chunk_size = MAX_PAYLOAD_BYTE;

	header.tx_header_bits.dnc = DNC_COMMANDTYPE_DATA;
	header.tx_header_bits.norx = NORX_NO_RECEIVE;
	header.tx_header_bits.dv = DV_DATA_VALID;
	for (uint32_t i = 0; i < chunk_count; i++) {
		header.tx_header_bits.sv = SV_START_INVALID;
		header.tx_header_bits.ev = EV_END_INVALID;
		header.tx_header_bits.ebo = 0;

		if (i == 0) { // First chunk
			header.tx_header_bits.sv = SV_START_VALID;
		}
		if (i == chunk_count - 1) {
			chunk_size = length % MAX_PAYLOAD_BYTE;
			if (chunk_size == 0) {
				chunk_size = MAX_PAYLOAD_BYTE;
			}
			header.tx_header_bits.ev = EV_END_VALID;
			header.tx_header_bits.ebo = chunk_size - 1;
		}

		header.tx_header_bits.p = 0;
		header.tx_header_bits.p = get_parity(header.data_frame_head);

		be_header = sys_cpu_to_be32(header.data_frame_head);
		memcpy(tx_buffer, &be_header, HEADER_SIZE);
		memcpy(tx_buffer + HEADER_SIZE, data + i * MAX_PAYLOAD_BYTE, MAX_PAYLOAD_BYTE);

		struct spi_buf tx_buf = {.buf = tx_buffer, .len = HEADER_SIZE + MAX_PAYLOAD_BYTE};
		const struct spi_buf_set tx_buf_set = {.buffers = &tx_buf, .count = 1};
		struct spi_buf rx_buf = {.buf = rx_buffer, .len = MAX_PAYLOAD_BYTE + FOOTER_SIZE};
		const struct spi_buf_set rx_buf_set = {.buffers = &rx_buf, .count = 1};
		if (spi_transceive_dt(spi_dev, &tx_buf_set, &rx_buf_set) != 0) {
			printk("SPI transceive failed while sending packet\n");
			return -1;
		}
	}

	return 0;
}

int receive_packet(const struct spi_dt_spec *spi_dev, uint8_t *data, uint16_t *length)
{
	uint8_t tx_buffer[HEADER_SIZE + MAX_PAYLOAD_BYTE] = {0};
	uint8_t rx_buffer[MAX_PAYLOAD_BYTE + FOOTER_SIZE] = {0};

	union data_header header;
	union data_footer footer;
	uint32_t be_header;
	uint32_t be_footer;
	size_t data_offset = 0;
	size_t chunk_size = MAX_PAYLOAD_BYTE;
	bool finished = false;

	*length = 0;

	header.tx_header_bits.dnc = DNC_COMMANDTYPE_DATA;
	header.tx_header_bits.norx = NORX_RECEIVE;
	header.tx_header_bits.dv = DV_DATA_INVALID;
	header.tx_header_bits.sv = SV_START_INVALID;
	header.tx_header_bits.ev = EV_END_INVALID;
	header.tx_header_bits.ebo = 0;
	header.tx_header_bits.p = get_parity(header.data_frame_head);
	while (*length < MAX_PACKET_SIZE && !finished) {
		be_header = sys_cpu_to_be32(header.data_frame_head);
		memcpy(tx_buffer, &be_header, HEADER_SIZE);

		struct spi_buf tx_buf = {.buf = tx_buffer, .len = HEADER_SIZE + MAX_PAYLOAD_BYTE};
		const struct spi_buf_set tx_buf_set = {.buffers = &tx_buf, .count = 1};
		struct spi_buf rx_buf = {.buf = rx_buffer, .len = MAX_PAYLOAD_BYTE + FOOTER_SIZE};
		const struct spi_buf_set rx_buf_set = {.buffers = &rx_buf, .count = 1};
		if (spi_transceive_dt(spi_dev, &tx_buf_set, &rx_buf_set) != 0) {
			printk("SPI transceive failed while receiving packet\n");
			return -1;
		}

		be_footer = *((uint32_t *)(rx_buffer + MAX_PAYLOAD_BYTE));
		footer.data_frame_foot = sys_be32_to_cpu(be_footer);

		if (footer.rx_footer_bits.p != get_parity(footer.data_frame_foot)) {
			printk("Parity error while receiving packet\n");
			return -1;
		}

		if (*length == 0) { /* First chunk */
			if (footer.rx_footer_bits.dv == DV_DATA_INVALID) {
				/* No data to be received */
				return 0;
			}

			if (footer.rx_footer_bits.sv == SV_START_INVALID) {
				//printk("Invalid start of the packet\n");
				return -1;
			}

			data_offset = (footer.rx_footer_bits.swo * 4); /* 4 bytes per word */
		} else {
			if (footer.rx_footer_bits.sv == SV_START_VALID) {
				//printk("Unexpected start of the packet\n");
				return -1;
			}
		}

		if (footer.rx_footer_bits.ev == EV_END_VALID) { /* Last chunk */
			chunk_size = footer.rx_footer_bits.ebo + 1;
			finished = true;
		}

		memcpy(data + *length, rx_buffer + data_offset, chunk_size - data_offset);
		*length += chunk_size - data_offset;
		data_offset = 0;
	}

	return 0;
}
```

## src/lan8651.h
```c
#include <stdint.h>

#include <zephyr/kernel.h>
#include <zephyr/drivers/spi.h>

#define MAX_CONTROL_CMD_LEN        (0x7F)
#define MAX_PAYLOAD_BYTE           (64)
#define REG_SIZE                   (4)
#define MAX_REG_DATA_ONECONTROLCMD (MAX_CONTROL_CMD_LEN * REG_SIZE)
#define MAX_REG_DATA_ONECHUNK      (MAX_PAYLOAD_BYTE / REG_SIZE)
#define MAX_DATA_DWORD_ONECHUNK    (MAX_REG_DATA_ONECHUNK)
#define HEADER_SIZE                (4)
#define FOOTER_SIZE                (4)
#define MAX_ENTRIES                (100)
#define MAX_PACKET_SIZE            (1500)

enum {
	ARP_E_SUCCESS = 0,
	ARP_E_REQUEST_FAILED,
	ARP_E_REPLY_FAILED,
	ARP_E_UNKNOWN_ERROR,
};

enum {
	SPI_E_SUCCESS = 0,
	SPI_E_UNKNOWN_ERROR,
	SPI_E_INIT_ERROR,
	SPI_E_ISR_INIT_ERROR,
};

enum {
	PLCA_MODE_COORDINATOR = 0,
	PLCA_MODE_FOLLOWER,
	PLCA_MODE_INVALID,
};

enum {
	MMS0 = 0x00,  /* Open Alliance 10BASE-T1x MAC-PHY Standard Registers */
	MMS1 = 0x01,  /* MAC Registers */
	MMS2 = 0x02,  /* PHY PCS Registers */
	MMS3 = 0x03,  /* PHY PMA/PMD Registers */
	MMS4 = 0x04,  /* PHY Vendor Specific Registers */
	MMS10 = 0x0A, /* Miscellaneous Register Descriptions */
};

/* MMS0, Open Alliance 10BASE-T1x MAC-PHY Standard Registers */
enum {
	OA_ID = 0x00,
	OA_PHYID = 0x01,
	OA_STDCAP = 0x02,
	OA_RESET = 0x03,
	OA_CONFIG0 = 0x04,
	OA_STATUS0 = 0x08,
	OA_STATUS1 = 0x09,
	OA_BUFSTS = 0X0B,
	OA_IMASK0 = 0x0C,
	OA_IMASK1 = 0x0D,
	TTSCAH = 0x10,
	TTSCAL = 0x11,
	TTSCBH = 0x12,
	TTSCBL = 0x13,
	TTSCCH = 0x14,
	TTSCCL = 0x15,
	BASIC_CONTROL = 0xFF00,
	BASIC_STATUS = 0xFF01,
	PHY_ID1 = 0xFF02,
	PHY_ID2 = 0xFF03,
	MMDCTRL = 0xFF0D,
	MMDAD = 0xFF0E
};

/* MMS1, MAC Registers */
enum {
	MAC_NCR = 0x00,
	MAC_NCFGR = 0x01,
	MAC_HRB = 0x20,
	MAC_HRT = 0x21,
	MAC_SAB1 = 0x22,
	MAC_SAT1 = 0x23,
	MAC_SAB2 = 0x24,
	MAC_SAT2 = 0x25,
	MAC_SAB3 = 0x26,
	MAC_SAT3 = 0x27,
	MAC_SAB4 = 0x28,
	MAC_SAT4 = 0x29,
	MAC_TIDM1 = 0x2A,
	MAC_TIDM2 = 0x2B,
	MAC_TIDM3 = 0x2C,
	MAC_TIDM4 = 0x2D,
	MAC_SAMB1 = 0x32,
	MAC_SAMT1 = 0x33,
	MAC_TISUBN = 0x6F,
	MAC_TSH = 0x70,
	MAC_TSL = 0x74,
	MAC_TN = 0x75,
	MAC_TA = 0x76,
	MAC_TI = 0x77,
	BMGR_CTL = 0x0200,
	STATS0 = 0x0208,
	STATS1 = 0x0209,
	STATS2 = 0x020A,
	STATS3 = 0x020B,
	STATS4 = 0x020C,
	STATS5 = 0x020D,
	STATS6 = 0x020E,
	STATS7 = 0x020F,
	STATS8 = 0x0210,
	STATS9 = 0x0211,
	STATS10 = 0x0212,
	STATS11 = 0x0213,
	STATS12 = 0x0214
};

/* MMS2, PHY PCS Registers */
enum {
	T1SPCSCTL = 0x08F3,
	T1SPCSSTS = 0x08F4,
	T1SPCSDIAG1 = 0x08F5,
	T1SPCSDIAG2 = 0x08F6
};

/* MMS3, PHY PMA/PMD Registers */
enum {
	T1PMAPMDEXTA = 0x12,
	T1PMAPMDCTL = 0x0834,
	T1SPMACTL = 0x08F9,
	T1SPMASTS = 0x08FA,
	T1STSTCTL = 0x08FB
};

/* MMS4, PHY Vendor Specific Registers */
enum {
	CTRL1 = 0x10,
	STS1 = 0x18,
	STS2 = 0x19,
	STS3 = 0x1A,
	IMSK1 = 0x1C,
	IMSK2 = 0x1D,
	CTRCTRL = 0x20,
	TOCNTH = 0x24,
	TOCNTL = 0x25,
	BCNCNTH = 0x26,
	BCNCNTL = 0x27,
	MULTID0 = 0x30,
	MULTID1 = 0x31,
	MULTID2 = 0x32,
	MULTID3 = 0x33,
	PRSSTS = 0x36,
	PRTMGMT2 = 0x3D,
	IWDTOH = 0x3E,
	IWDTOL = 0x3F,
	TXMCTL = 0x40,
	TXMPATH = 0x41,
	TXMPATL = 0x42,
	TXMMSKH = 0x43,
	TXMMSKL = 0x44,
	TXMLOC = 0x45,
	TXMDLY = 0x49,
	RXMCTL = 0x50,
	RXMPATH = 0x51,
	RXMPATL = 0x52,
	RXMMSKH = 0x53,
	RXMMSKL = 0x54,
	RXMLOC = 0x55,
	RXMDLY = 0x59,
	CBSSPTHH = 0x60,
	CBSSPTHL = 0x61,
	CBSSTTHH = 0x62,
	CBSSTTHL = 0x63,
	CBSSLPCTL = 0x64,
	CBSTPLMTH = 0x65,
	CBSTPLMTL = 0x66,
	CBSBTLMTH = 0x67,
	CBSBTLMTL = 0x68,
	CBSCRCTRH = 0x69,
	CBSCRCTRL = 0x6A,
	CBSCTRL = 0x6B,
	PLCASKPCTL = 0x70,
	PLCATOSKP = 0x71,
	ACMACTL = 0x74,
	SLPCTL0 = 0x80,
	SLPCTL1 = 0x81,
	CDCTL0 = 0x87,
	SQICTL = 0xA0,
	SQISTS0 = 0xA1,
	SQICFG0 = 0xAA,
	SQICFG2 = 0xAC,
	ANALOG5 = 0xD5,
	MIDVER = 0xCA00,
	PLCA_CTRL0 = 0xCA01,
	PLCA_CTRL1 = 0xCA02,
	PLCA_STS = 0xCA03,
	PLCA_TOTMR = 0xCA04,
	PLCA_BURST = 0xCA05
};

/* MMS10, Miscellaneous Register Descriptions */
enum {
	QTXCFG = 0x81,
	QRXCFG = 0x82,
	PADCTRL = 0x88,
	CLKOCTL = 0x89,
	MISC = 0x8C,
	DEVID = 0x94,
	BUSPCS = 0x96,
	CFGPRTCTL = 0x99,
	ECCCTRL = 0x0100,
	ECCSTS = 0x0101,
	ECCFLTCTRL = 0x0102,
	EC0CTRL = 0x0200,
	EC1CTRL = 0x0201,
	EC2CTRL = 0x0202,
	EC3CTRL = 0x0203,
	ECRDSTS = 0x0204,
	ECTOT = 0x0205,
	ECCLKSH = 0x0206,
	ECCLKSL = 0x0207,
	ECCLKNS = 0x0208,
	ECRDTS0 = 0x0209,
	ECRDTS1 = 0x020A,
	ECRDTS2 = 0x020B,
	ECRDTS3 = 0x020C,
	ECRDTS4 = 0x020D,
	ECRDTS5 = 0x020E,
	ECRDTS6 = 0x020F,
	ECRDTS7 = 0x0210,
	ECRDTS8 = 0x0211,
	ECRDTS9 = 0x0212,
	ECRDTS10 = 0x0213,
	ECRDTS11 = 0x0214,
	ECRDTS12 = 0x0215,
	ECRDTS13 = 0x0216,
	ECRDTS14 = 0x0217,
	ECRDTS15 = 0x0218,
	PACYC = 0x021F,
	PACTRL = 0x0220,
	EG0STNS = 0x0221,
	EG0STSECL = 0x0222,
	EG0STSECH = 0x0223,
	EG0PW = 0x0224,
	EG0IT = 0x0225,
	EG0CTL = 0x0226,
	EG1STNS = 0x0227,
	EG1STSECL = 0x0228,
	EG1STSECH = 0x0229,
	EG1PW = 0x022A,
	EG1IT = 0x022B,
	EG1CTL = 0x022C,
	EG2STNS = 0x022D,
	EG2STSECL = 0x022E,
	EG2STSECH = 0x022F,
	EG2PW = 0x0230,
	EG2IT = 0x0231,
	EG2CTL = 0x0232,
	EG3STNS = 0x0233,
	EG3STSECL = 0x0234,
	EG3STSECH = 0x0235,
	EG3PW = 0x0236,
	EG3IT = 0x0237,
	EG3CTL = 0x0238,
	PPSCTL = 0X0239,
	SEVINTEN = 0x023A,
	SEVINTDIS = 0x023B,
	SEVIM = 0x023C,
	SEVSTS = 0x023D
};

struct reginfo {
	char *desc;
	int32_t address;
};

enum {
	DNC_COMMANDTYPE_CONTROL = 0,
	DNC_COMMANDTYPE_DATA = 1,
};

enum {
	REG_ADDR_INCREMENT_ENABLE = 0,
	REG_ADDR_INCREMENT_DISABLE = 1,
};

enum {
	REG_COMMAND_TYPE_READ = 0,
	REG_COMMAND_TYPE_WRITE
};

enum {
	NORX_RECEIVE = 0,
	NORX_NO_RECEIVE = 1,
};

enum {
	DV_DATA_INVALID = 0,
	DV_DATA_VALID = 1,
};

enum {
	SV_START_INVALID = 0,
	SV_START_VALID = 1,
};

enum {
	EV_END_INVALID = 0,
	EV_END_VALID = 1,
};

enum {
	HDRB_HEADER_OK = 0,
	HDRB_HEADER_BAD = 1,
};

struct ctrl_cmd_reg {
	uint8_t memorymap;
	uint8_t length;
	uint16_t address;
	uint32_t databuffer[MAX_CONTROL_CMD_LEN];
};

union ctrl_header {
	uint32_t ctrl_frame_head;
	struct {
		uint32_t p: 1;
		uint32_t len: 7;
		uint32_t addr: 16;
		uint32_t mms: 4;
		uint32_t aid: 1;
		uint32_t wnr: 1;
		uint32_t hdrb: 1;
		uint32_t dnc: 1;
	} ctrl_head_bits;
};

union data_header {
	uint32_t data_frame_head;
	struct {
		uint32_t p: 1;
		uint32_t rsvd3: 5;
		uint32_t tsc: 2;
		uint32_t ebo: 6;
		uint32_t ev: 1;
		uint32_t rsvd2: 1;
		uint32_t swo: 4;
		uint32_t sv: 1;
		uint32_t dv: 1;
		uint32_t vs: 2;
		uint32_t rsvd1: 5;
		uint32_t norx: 1;
		uint32_t seq: 1;
		uint32_t dnc: 1;
	} tx_header_bits;
};

union data_footer {
	uint32_t data_frame_foot;
	struct {
		uint32_t p: 1;
		uint32_t txc: 5;
		uint32_t rtps: 1;
		uint32_t rtsa: 1;
		uint32_t ebo: 6;
		uint32_t ev: 1;
		uint32_t fd: 1;
		uint32_t swo: 4;
		uint32_t sv: 1;
		uint32_t dv: 1;
		uint32_t vs: 2;
		uint32_t rba: 5;
		uint32_t sync: 1;
		uint32_t hdrb: 1;
		uint32_t exst: 1;
	} rx_footer_bits;
};

uint8_t get_parity(uint32_t valueToCalculateParity);
uint32_t write_register(const struct spi_dt_spec *spi_dev, uint8_t mms, uint16_t address,
			uint32_t data);
uint32_t read_register(const struct spi_dt_spec *spi_dev, uint8_t mms, uint16_t address);
int set_register(const struct spi_dt_spec *spi_dev, uint8_t node_count, uint8_t node_id, const uint8_t* mac_address);

int send_packet(const struct spi_dt_spec *spi_dev, const uint8_t *data, uint16_t length);
int receive_packet(const struct spi_dt_spec *spi_dev, uint8_t *data, uint16_t *length);
```

## src/spi.h
```c
#ifndef SPI_H
#define SPI_H

#include <stdint.h>

#include <zephyr/sys/printk.h>
#include <zephyr/sys/byteorder.h>

#define SPI_BASE 0xA0100000

#define SPI_DATA(base)       (base + 0x00)
#define SPI_STAT(base)       (base + 0x04)
#define SPI_INTEN(base)      (base + 0x08)
#define SPI_MODE(base)       (base + 0x0c)
#define SPI_CTRL(base)       (base + 0x10)
#define SPI_EVTCTRL(base)    (base + 0x14)
#define SPI_DMA_CTRL(base)   (base + 0x2c)
#define SPI_DMA_STATUS(base) (base + 0x30)
#define SPI_TXBASE(base)     (base + 0x20)
#define SPI_RXBASE(base)     (base + 0x24)
#define SPI_PACKET(base)     (base + 0x28)
#define SPI_DMA_ICR(base)    (base + 0x34)

#define SPI_INTEN_DR BIT(30)
#define SPI_INTEN_DW BIT(31)

#define SPI_DMA_CTR_EN   BIT(0)
#define SPI_DMA_CTR_PCLR BIT(2)
#define SPI_DMA_CTR_DRE  BIT(30)
#define SPI_DMA_CTR_DTE  BIT(31)

#define SPI_DMA_ICR_IED BIT(17)
#define SPI_DMA_ICR_ISD BIT(29)

#define SPI_WORD_BYTES 4

int transceive(uint8_t* tx_buf, uint8_t* rx_buf, uint32_t length);
void setup_dma();

#endif /* SPI_H */
```

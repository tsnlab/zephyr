/*
 * Copyright 2024 Hounjoung Rim <hounjoung@tsnlab.com>
 *
 * SPDX-License-Identifier: Apache-2.0
 */

/dts-v1/;
#include <tcc/tcc7045.dtsi>

/ {
	model = "Telechips TOPST VCP-45 board";
	compatible = "tcc,topst_vcp_45";

	chosen {
		zephyr,console = &uart0;
		zephyr,shell-uart = &uart0;
		zephyr,sram = &sram0;
	};
};

&sram0 {
	reg = <0 DT_SIZE_K(448)>, <0x70000 DT_SIZE_K(320)>;
};

&uart0 {
	clock-frequency = <1846153>;
	current-speed = <115200>;
	status = "okay";
};

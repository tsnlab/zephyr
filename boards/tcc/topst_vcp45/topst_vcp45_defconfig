## boards/tcc/topst_vcp45/topst_vcp45_defconfig
```kconfig
# SPDX-License-Identifier: Apache-2.0
# Copyright 2024 Hounjoung Rim <hounjoung@tsnlab.com>

CONFIG_XIP=n

CONFIG_MAX_THREAD_BYTES=3

CONFIG_THREAD_STACK_INFO=y

CONFIG_SRAM_VECTOR_TABLE=y

CONFIG_SYSCON=y

#Enable UART driver
CONFIG_SERIAL=y

CONFIG_TIMEOUT_64BIT=y

CONFIG_GPIO=y

#Enable console
CONFIG_CONSOLE=y

CONFIG_UART_CONSOLE=n
CONFIG_UART_CONSOLE_DEBUG_SERVER_HOOKS=n
CONFIG_UART_CONSOLE_MCUMGR=n

CONFIG_CBPRINTF_LIBC_SUBSTS=y

CONFIG_SYS_CLOCK_TICKS_PER_SEC=1000
CONFIG_ARM_MPU = y CONFIG_GEN_IRQ_VECTOR_TABLE=y
CONFIG_USERSPACE=y
CONFIG_INIT_STACKS=y
```

## boards/tcc/topst_vcp_45/Kconfig.topst_vcp_45
```kconfig
# SPDX-License-Identifier: Apache-2.0
#
# Copyright 2024 Hounjoung Rim <hounjoung@tsnlab.com>

config BOARD_TOPST_VCP_45
	select SOC_TCC7045
```

## boards/tcc/topst_vcp_45/topst_vcp_45_defconfig
```kconfig
# SPDX-License-Identifier: Apache-2.0
#
# Copyright 2024 Hounjoung Rim <hounjoung@tsnlab.com>
#

CONFIG_CONSOLE=y
CONFIG_UART_CONSOLE=y
CONFIG_SERIAL=y
```

## drivers/mfd/Kconfig.rp1
```kconfig
# Copyright (c) 2024 Junho Lee <junho@tsnlab.com>
# SPDX -License-Identifier: Apache-2.0

config MFD_RP1
	bool "RP1 peripheral controller driver"
	default y
	help
	  Enable driver for RP1 peripheral controller on Raspberry Pi 5.
```

## drivers/spi/Kconfig.bcm2711
```kconfig
# TODO: Copyright

config SPI_BCM2711
	bool "TODO"
	default y
	depends on DT_HAS_BRCM_BCM2711_SPI_ENABLED
	help
	  TODO
```

## drivers/spi/Kconfig.tccvcp
```kconfig
# Copyright (c) 2025 Junho Lee <junho@tsnlab.com>
# SPDX-License-Identifier: Apache-2.0

config SPI_TCCVCP
	bool "Telechips TOPST VCP SoC SPI Driver"
	default y
	depends on DT_HAS_TCC_TCCVCP_SPI_ENABLED
	help
	  Enable Driver for Telechips TOPST VCP SoC SPI Controller.
```

## drivers/timer/Kconfig.tcc_vcpttc
```kconfig
# Copyright 2024 Hounjoung Rim <hounjoung@tsnlab.com>
# SPDX-License-Identifier: Apache-2.0

config TCC_VCPTTC_TIMER
	bool "Telechips VCP ttc timer support"
	default y
	depends on DT_HAS_TCC_TTCVCP_ENABLED
	select TICKLESS_CAPABLE
	help
	  This module implements a kernel device driver for the Telechips VCP
	  platform provides the standard "system clock driver" interfaces.
	  If unchecked, no timer will be used.
```

## dts/bindings/spi/brcm,bcm2711-spi.yaml
```yaml
# TODO

description: Broadcom BCM2711 SPI

compatible: "brcm,bcm2711-spi"

include: [spi-controller.yaml]

properties:
  reg:
    required: true

  clk-gpios:
    type: phandle-array
    required: true
    description: |
      GPIO pin for SPI clock

  miso-gpios:
    type: phandle-array
    required: true
    description: |
      GPIO pin for SPI MISO

  mosi-gpios:
    type: phandle-array
    required: true
    description: |
      GPIO pin for SPI MOSI
```

## dts/bindings/spi/tcc,tccvcp-spi.yaml
```yaml
# Copyright (c) 2025 Junho Lee <junho@tsnlab.com>
# SPDX-License-Identifier: Apache-2.0

description: Telechips TOPST VCP SoC SPI Driver

compatible: "tcc,tccvcp-spi"

include: [spi-controller.yaml]

properties:
  reg:
    required: true
  
  clk-gpios:
    type: phandle-array
    required: true
    description: |
      GPIO pin for SPI clock
  
  miso-gpios:
    type: phandle-array
    required: true
    description: |
      GPIO pin for SPI MISO

  mosi-gpios:
    type: phandle-array
    required: true
    description: |
      GPIO pin for SPI MOSI
```

## samples/realtime_test_stress_on/sample.yaml
```yaml
sample:
  description: Realtime test app
    application
  name: realtime test
common:
  tags: introduction
  integration_platforms:
    - native_sim
  harness: console
  harness_config:
    type: one_line
    regex:
      - "realtime_test_app(.*)"
tests:
  sample.basic.helloworld:
    tags: introduction
```

## samples/t1s/tickle/Kconfig
```kconfig
# Copyright (c) 2025 Junho Lee <junho@tsnlab.com>
# SPDX-License-Identifier: Apache-2.0

config ZEPHYR_TICKLE_MODULE
	bool

config TICKLE
	bool "TickLE support"
	help
	  TODO
```

## soc/tcc/tcc7045/Kconfig
```kconfig
# Copyright (c) 2019 Lexmark International, Inc.
# Copyright (c) 2019 Stephanos Ioannidis <root@stephanos.io>
# SPDX-License-Identifier: Apache-2.0

config SOC_TCC7045
	select ARM
	select CPU_CORTEX_R5
	select PLATFORM_SPECIFIC_INIT
	select CPU_HAS_ARM_MPU
	select VFP_DP_D16
```

## soc/tcc/tcc7045/Kconfig.soc
```kconfig
# Copyright (c) 2019 Lexmark International, Inc.
# Copyright (c) 2019 Stephanos Ioannidis <root@stephanos.io>
# SPDX-License-Identifier: Apache-2.0

config SOC_TCC7045
	bool

config SOC
	default "tcc7045" if SOC_TCC7045
```

## soc/telechips/tcc7045/Kconfig.defconfig
```kconfig
# Copyright 2024 Hounjoung Rim <hounjoung@tsnlab.com>
# SPDX-License-Identifier: Apache-2.0

if SOC_TCC7045

config NUM_IRQS
	int
	default 220

config SYS_CLOCK_HW_CYCLES_PER_SEC
	int
	default 2000000

endif
```

## drivers/ethernet/Kconfig.lan865x
```kconfig
# Copyright (c) 2023 DENX Software Engineering GmbH
# SPDX-License-Identifier: Apache-2.0

menuconfig ETH_LAN865X
	bool "LAN865X 10BASE-T1S Controller"
	default y
	depends on DT_HAS_MICROCHIP_LAN865X_ENABLED
	select SPI
	select NET_L2_ETHERNET_MGMT
	help
	  The LAN865X is a low power, 10BASE-T1S transceiver compliant with
	  the IEEE® 802.3cg-2019™ Ethernet standard for long reach, 10
	  Mbps single pair Ethernet (SPE).

	  Featuring an integrated media access control (MAC) and a PHY,
	  the LAN865X enables direct connectivity with a variety of controllers
	  via a serial peripheral inter-face (SPI).

if ETH_LAN865X

config ETH_LAN865X_INIT_PRIORITY
	int "LAN865X driver init priority"
	default 50
	help
	  LAN865X device driver initialization priority.
	  Must be initialized after SPI.


config ETH_LAN865X_IRQ_THREAD_STACK_SIZE
	int "Stack size for a thread that processes IRQ and Polling"
	default 512
	help
	  Size of the stack used for internal thread which is ran to
	  process raised INT IRQ and Polling.

config ETH_LAN865X_IRQ_THREAD_PRIO
	int "Priority for internal incoming packet handler"
	default 10
	help
	  Priority level for internal thread which is ran for LAN
	  INT IRQ and Polling processing.

config ETH_LAN865X_TIMEOUT
	int "IP buffer timeout"
	default 100
	help
	  Given timeout in milliseconds. Maximum amount of time
	  that the driver will wait from the IP stack to get
	  a memory buffer.

config ETH_LAN865X_POLL_INTERVAL_MS
	int "LAN865x polling interval (ms)"
	default 1
	range 1 1000
	help
	  Polling interval used when IRQ is disabled or unavailable.
	  Smaller values reduce RX latency but increase CPU load.

config ETH_LAN865X_USE_IRQ
	bool "Use LAN865X IRQ mode"
	default n
	help
	  Enable GPIO interrupt based RX handling for LAN865X.
	  If disabled, the driver operates in polling mode.

config ETH_LAN865X_BURST_CHUNKS
	int "LAN865x burst chunk count"
	default 1
	range 1 128
	help
	  Number of data chunks transferred in one SPI transaction
	  for both RX and TX paths of the LAN865x driver.

	  Each chunk carries 64 bytes of payload.
	  Value 1 keeps the legacy single-chunk behavior.
	  Larger values increase burst size and may improve throughput.

config ETH_LAN865X_OA_TC6_CREDIT_BASED_XFER
	bool "Use credit-based OA-TC6 transaction path"
	default y
	help
	  Enable the credit-based OA-TC6 data transaction path for LAN865X.

	  When enabled, the OA-TC6 layer builds SPI data transactions
	  from TX credit and RX chunk availability instead of using
	  the legacy send/read chunk paths.

	  This path keeps the OA-TC6 transaction logic generic and
	  allows the underlying SPI controller driver to use an
	  optimized transfer path when available.

endif # ETH_LAN865X
```

## drivers/pinctrl/Kconfig.rp1
```kconfig
# Copyright (c) 2026 TSNLab
# SPDX-License-Identifier: Apache-2.0

menuconfig PINCTRL_RP1
	bool "Raspberry Pi 5 RP1 pin controller driver"
	depends on PINCTRL
	depends on SOC_BCM2712
	default y if BOARD_RPI_5
	help
	  Enable pin control driver for Raspberry Pi RP1 GPIO block
	  used on Raspberry Pi 5.

if PINCTRL_RP1

module = PINCTRL_RP1
module-str = PINCTRL_RP1
source "subsys/logging/Kconfig.template.log_config"

endif # PINCTRL_RP1
```

## drivers/spi/Kconfig.dw
```kconfig
# DesignWare SPI driver configuration options

# Copyright (c) 2015-2016 Intel Corporation
# Copyright (c) 2023 Meta Platforms
# SPDX-License-Identifier: Apache-2.0

menuconfig SPI_DW
	bool "DesignWare SPI controller driver"
	default y
	depends on DT_HAS_SNPS_DESIGNWARE_SPI_ENABLED
	select PINCTRL if $(dt_compat_any_has_prop,$(DT_COMPAT_SNPS_DESIGNWARE_SPI),pinctrl-0)
	help
	  Enable support for DesignWare SPI controllers.

if SPI_DW

config SPI_DW_ACCESS_WORD_ONLY
	bool "DesignWare SPI only allows word access"
	help
	  In some case, e.g. ARC HS Development kit, the peripheral space of
	  DesignWare SPI only allows word access, byte access will raise
	  exception.

config SPI_DW_HSSI
	bool "DesignWare SPI HSSI variant"
	help
	  Use register layout compatible with the SPI DW HSSI variant of the
	  peripheral.

config SPI_DW_USE_IRQ
	bool "Use DesignWare SPI IRQ mode"
	default n
	help
	  When enabled, SPI transfers are completed using
	  interrupt-driven TX/RX FIFO handling.
	  When disabled, SPI operates in polling mode.

config SPI_DW_POLLING_TIMEOUT_US
	int "DesignWare SPI polling timeout (us)"
	default 1000
	depends on SPI
	help
	  Timeout for DesignWare SPI controller when operating
	  in polling mode. Unit is microseconds.

	  This value limits how long the driver will poll
	  TX/RX FIFO status before returning -ETIMEDOUT.


endif # SPI_DW
```

## samples/rpi5_pinctrl/sample.yaml
```yaml
sample:
  description: Raspberry Pi 5 RP1 pinctrl sample application (ALT mode cycling + CTRL readback)
  name: rpi5_pinctrl

common:
  min_ram: 2
  min_flash: 16
  tags: rpi5_pinctrl pinctrl rp1 rpi5
  integration_platforms:
    - rpi_5
  harness: console
  harness_config:
    type: one_line
    regex:
      - "=== RP1 PINCTRL MODE CYCLING TEST ==="
      - "RP1 pinctrl mapped: gpio=.* pads=.*"
      - "Setting GPIO17 -> ALT[0-5]"
      - "CTRL = 0x[0-9a-fA-F]{8}"
```
